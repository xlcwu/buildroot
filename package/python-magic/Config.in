## package/python-magic/Config.in
```kconfig
config BR2_PACKAGE_PYTHON_MAGIC
	bool "python-magic"
	help
	  File type identification using libmagic.

	  http://github.com/ahupp/python-magic
```

## package/python-pip/Config.in
```kconfig
config BR2_PACKAGE_PYTHON_PIP
        bool "python-pip"
        help
	  pip is a package management system used to install
	  and manage software packages written in Python.

	  https://pip.pypa.io/
```

## package/python-s3cmd/Config.in
```kconfig
config BR2_PACKAGE_PYTHON_S3CMD
	bool "python-s3cmd"
	select BR2_PACKAGE_PYTHON_DATEUTIL # runtime
	select BR2_PACKAGE_PYTHON_MAGIC # runtime
	help
	  Command line tool for managing Amazon S3 and CloudFront services.

	  http://s3tools.org
```
